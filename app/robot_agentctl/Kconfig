## app/robot_agentctl/Kconfig
```kconfig
config LVX_USE_DEMO_CONTEST2026_295_ROBOT_AGENTCTL
	bool "Contest robot proactive control"
	default y
	depends on EXAMPLES_AI_AGENT_VELA
	depends on LVX_USE_DEMO_CONTEST2026_295_ROBOT_VOICE
	---help---
		Build the robot_agentctl proactive runtime diagnostic command.
```

## app/robot_voice/Kconfig
```kconfig
config LVX_USE_DEMO_CONTEST2026_295_ROBOT_VOICE
	bool "Contest robot voice"
	default n
	depends on I2S && AUDIO && NETUTILS_CJSON
	depends on TFLITEMICRO
	---help---
		Build robot_voice with local INT8 TFLite Micro acoustic wakeword.
		Import a validated model bundle before building. Cloud ASR is used
		only for conversation commands after acoustic activation.
```

## app/robotctl/Kconfig
```kconfig
#
# Contest 2026 EDA Robot control application
#

config LVX_USE_DEMO_CONTEST2026_295_ROBOTCTL
	bool "EDA Robot control"
	default n
	depends on PWM && PWM_MULTICHAN
	---help---
		Build the robotctl NSH builtin for the contest ESP32-S3 board.
		The application uses /dev/pwm0 only when a motion command is run.
```

## app/voice_echo/Kconfig
```kconfig
#
# Contest 2026 raw PCM voice echo application
#

config LVX_USE_DEMO_CONTEST2026_295_VOICE_ECHO
	bool "Contest voice echo"
	default n
	depends on I2S && AUDIO
	---help---
		Build the voice_echo NSH builtin. The application records raw PCM from
		I2S0; the recordmem command keeps a three-second capture in memory and
		submits it directly to the ASR backend.
```

## board/contest_board/Kconfig
```kconfig
#
# ESP32-S3-WROOM-1-N16R8 contest board configuration
#

if ARCH_BOARD_CUSTOM

comment "Contest 2026 team 295 ESP32-S3 board options"

config CONTEST_BOARD_BUTTONS
	bool "Contest board button capability"
	default y
	select ARCH_HAVE_BUTTONS
	select ARCH_HAVE_IRQBUTTONS
	---help---
		Keep the board button capability configuration for compatibility.
		Actual contest-board button registration is controlled separately.

config CONTEST_BOARD_REGISTER_BUTTONS
	bool "Register contest-board buttons at runtime"
	default n
	depends on CONTEST_BOARD_BUTTONS
	---help---
		Register board buttons and configure their GPIOs at runtime.

config CONTEST_BOARD_I2S0_RX
	bool "Contest-local I2S0 microphone RX lower-half"
	default y if ESP32S3_I2S0_RX
	depends on ESP32S3_I2S0_RX
	---help---
		Use the contest board's I2S0 RX lower-half for the INMP441
		microphone.

config CONTEST_BOARD_I2S1_TX
	bool "Contest-local I2S1 speaker TX lower-half"
	default y if ESP32S3_I2S1_TX
	depends on ESP32S3_I2S1_TX
	---help---
		Use the contest board's I2S1 TX lower-half for the MAX98357 speaker.

endif # ARCH_BOARD_CUSTOM
```
